## payloads/ram/Kconfig
```kconfig
##
## This file is part of the ram project.
##
## Copyright (C) 2008 Uwe Hermann <uwe@hermann-uwe.de>
##
## This program is free software; you can redistribute it and/or modify
## it under the terms of the GNU General Public License as published by
## the Free Software Foundation; version 2 of the License.
##
## This program is distributed in the hope that it will be useful,
## but WITHOUT ANY WARRANTY; without even the implied warranty of
## MERCHANTABILITY or FITNESS FOR A PARTICULAR PURPOSE.  See the
## GNU General Public License for more details.
##

#
# For a description of the syntax of this configuration file,
# see http://lxr.linux.no/source/Documentation/kbuild/kconfig-language.txt.
#

mainmenu "ram Configuration"

menu "General settings"

config PAYLOAD_INFO_NAME
	string "Payload name"
	default "ram"
	help
	  The name of this payload for use in (e.g.) Bayou.

config PAYLOAD_INFO_LISTNAME
	string "Payload menu entry name"
	default "ram payload"
	help
	  The name of this payload's menu entry for use in (e.g.) Bayou.

config PAYLOAD_INFO_DESC
	string "Payload description"
	default "A ram payload loader"
	help
	  The description of this payload for use in (e.g.) Bayou.

config PAYLOAD_INFO_VERSION
	string "Payload version"
	default "0.1"
	help
	  The version number of this payload.

endmenu

menu "Modules"

config MODULE_ACPI
	bool "Generate ACPI tables"
	default y
	help
	  This option enables ACPI table generation

endmenu
```

## src/cpu/amd/Kconfig
```kconfig
source "src/cpu/amd/agesa/Kconfig"
source "src/cpu/amd/pi/Kconfig"
source "src/cpu/amd/romepsp/Kconfig"
```

## src/mainboard/amd/rome/Kconfig
```kconfig
# SPDX-License-Identifier: GPL-2.0-or-later

if BOARD_AMD_ROME

config BOARD_SPECIFIC_OPTIONS
	def_bool y
	select SOC_AMD_COMMON_BLOCK_USE_ESPI
	select SOC_AMD_PICASSO
	select BOARD_ROMSIZE_KB_8192
	select DISABLE_SPI_FLASH_ROM_SHARING
	select DRIVERS_GENERIC_GPIO_KEYS
	select DRIVERS_I2C_GENERIC
	select DRIVERS_I2C_HID
	select HAVE_ACPI_TABLES
	select GOOGLE_SMBIOS_MAINBOARD_VERSION
	select PICASSO_CONSOLE_UART
	select PCIEXP_ASPM
	select PCIEXP_CLK_PM
	select PCIEXP_COMMON_CLOCK
	select PCIEXP_L1_SUB_STATE

config ELOG_BOOT_COUNT_CMOS_OFFSET
	int
	default 144

# FMDFILE is set here so that coreboot build picks up this flash map layout
# even when CHROMEOS is not selected when building upstream.
config FMDFILE
	string
	default "src/mainboard/\$(CONFIG_MAINBOARD_DIR)/chromeos.fmd"

config MAINBOARD_DIR
	string
	default "amd/rome"

config MAINBOARD_PART_NUMBER
	string
	default "rome"

config DEVICETREE
	string
	default "devicetree.cb"

config MAINBOARD_FAMILY
	string
	default "AMD_Rome"

config MAX_CPUS
	int
	default 8

config ONBOARD_VGA_IS_PRIMARY
	bool
	default n

config VBOOT
	select EC_GOOGLE_CHROMEEC_SWITCHES
	select VBOOT_LID_SWITCH

config VBOOT_VBNV_OFFSET
	hex
	default 0x2A

config CHROMEOS
	# Use default libpayload config
	select LP_DEFCONFIG_OVERRIDE if PAYLOAD_DEPTHCHARGE

config AMD_FWM_POSITION_INDEX
	int
	default 2

config DRIVER_TPM_I2C_BUS
	hex
	default 0x03

config DRIVER_TPM_I2C_ADDR
	hex
	default 0x50

config PICASSO_FW_A_POSITION
	hex
	default 0xFF031040
	depends on VBOOT_SLOTS_RW_AB && VBOOT_STARTS_BEFORE_BOOTBLOCK
	help
	  Location of the AMD firmware in the RW_A region. This is the
	  start of the RW-A region + 64 bytes for the cbfs header.

config PICASSO_FW_B_POSITION
	hex
	default 0xFF3CF040
	depends on VBOOT_SLOTS_RW_AB && VBOOT_STARTS_BEFORE_BOOTBLOCK
	help
	  Location of the AMD firmware in the RW_B region. This is the
	  start of the RW-A region + 64 bytes for the cbfs header.

config VARIANT_HAS_FW_CONFIG
	bool
	help
	  Honor FW_CONFIG in CBI.

config VARIANT_BOARD_VER_FW_CONFIG_VALID
	int
	default 256
	depends on VARIANT_HAS_FW_CONFIG
	help
	  Which board version did FW_CONFIG become valid in CBI.

config VARIANT_SUPPORTS_PRE_V3_SCHEMATICS
	bool
	default n
	help
	  Whether this variant supports pre-v3 version of schematics.
	  Eventually, when a variant moves to a point where it no
	  longer has to support pre-v3 schematics, `default y` entry
	  for it can be dropped.

config VARIANT_MIN_BOARD_ID_V3_SCHEMATICS
	int
	default 256
	help
	  Minimum board version where the variant starts supporting
	  v3 version of reference schematics.

config VARIANT_SUPPORTS_WIFI_POWER_ACTIVE_HIGH
	bool
	default n
	default n
	help
	  Whether this variant supports active high power enable for
	  WiFi. For pre-v3 schematics, this is always true. There are
	  some variants which used v3 schematics, but did not pick up
	  the change for active low WiFi power enable. Those variants
	  will have to set this config to true. Eventually, when a
	  variant needs to only support v3 schematics with active low
	  power enable for WiFi, `default y` entry for it can be
	  dropped.

config VARIANT_MIN_BOARD_ID_WIFI_POWER_ACTIVE_LOW
	int
	depends on VARIANT_SUPPORTS_WIFI_POWER_ACTIVE_HIGH
	default VARIANT_MIN_BOARD_ID_V3_SCHEMATICS
	help
	  Minimum board version where the variant starts supporting
	  active low power enable for WiFi.

config VBOOT_STARTS_BEFORE_BOOTBLOCK
	bool "PSP verstage"
	default y if VBOOT
	help
	  Firmware verification happens before the main processor is brought
	  online.

config VBOOT_STARTS_IN_BOOTBLOCK
	bool "X86 verstage (in bootblock)"
	depends on  VBOOT && ! VBOOT_STARTS_BEFORE_BOOTBLOCK
	select VBOOT_SEPARATE_VERSTAGE
	help
	  Firmware verification happens during the end of or right after the
	  bootblock. This implies that a static VBOOT2_WORK() buffer must be
	  allocated in memlayout.

endif # BOARD_AMD_ROME
```

## src/mainboard/amd/romepsp/Kconfig
```kconfig
if BOARD_AMD_ROMEPSP

config BOARD_SPECIFIC_OPTIONS
	def_bool y
	select ARCH_BOOTBLOCK_X86_32
	select ARCH_VERSTAGE_X86_32
	select ARCH_ROMSTAGE_X86_32
	select ARCH_RAMSTAGE_X86_32
	select CPU_AMD_ROMEPSP
	select IOAPIC_INTERRUPTS_ON_APIC_SERIAL_BUS
	select HAVE_CMOS_DEFAULT
	select HAVE_OPTION_TABLE
	select HAVE_ACPI_TABLES
	select BOARD_ROMSIZE_KB_2048 if !VBOOT
	select BOARD_ROMSIZE_KB_16384 if VBOOT
	select SUPERIO_ASPEED_AST2400
	select HAVE_UART_SPECIAL
	select DRIVERS_I2C_DESIGNWARE
	select SOC_AMD_COMMON
	select SOC_AMD_COMMON_BLOCK
	select SOC_AMD_COMMON_BLOCK_HAS_ESPI
	select SOC_AMD_COMMON_BLOCK_IOMMU
	select SOC_AMD_COMMON_BLOCK_ACPIMMIO
	select SOC_AMD_COMMON_BLOCK_BANKED_GPIOS
	select SOC_AMD_COMMON_BLOCK_ACPI
	select SOC_AMD_COMMON_BLOCK_GRAPHICS
	select SOC_AMD_COMMON_BLOCK_LPC
	select SOC_AMD_COMMON_BLOCK_PCI
	select SOC_AMD_COMMON_BLOCK_HDA
	select SOC_AMD_COMMON_BLOCK_SATA
	select SOC_AMD_COMMON_BLOCK_SMBUS
	select SOC_AMD_COMMON_BLOCK_PSP_GEN2
	select IOAPIC
	select DRIVERS_GENERIC_IOAPIC

config VBOOT
	select VBOOT_MUST_REQUEST_DISPLAY
	select VBOOT_STARTS_IN_BOOTBLOCK
	select VBOOT_SEPARATE_VERSTAGE
	select VBOOT_VBNV_CMOS
	select VBOOT_NO_BOARD_SUPPORT if !CHROMEOS
	select GBB_FLAG_DISABLE_LID_SHUTDOWN
	select GBB_FLAG_DISABLE_PD_SOFTWARE_SYNC
	select GBB_FLAG_DISABLE_EC_SOFTWARE_SYNC
	select GBB_FLAG_DISABLE_FWMP

config FMDFILE
	string
	default "src/mainboard/$(CONFIG_MAINBOARD_DIR)/vboot-rwa-16M.fmd" if VBOOT_SLOTS_RW_A && !VBOOT_SLOTS_RW_AB
	default "src/mainboard/$(CONFIG_MAINBOARD_DIR)/vboot-rwab-16M.fmd" if VBOOT_SLOTS_RW_AB

if VBOOT

config VBOOT_SLOTS_RW_A
	default y

endif

config VBOOT_VBNV_OFFSET
	hex
	default 0x2c

config MAINBOARD_DIR
	string
	default "amd/romepsp"

config MAINBOARD_PART_NUMBER
	string
	default "AMD Rome PSP board"

config MMCONF_BASE_ADDRESS
	hex
	default 0xb0000000

# fw_cfg tables can be larger than the default when TPM is enabled
config MAX_ACPI_TABLE_SIZE_KB
	int
	default 224

# Skip the first 64KiB as coreboot table pointer is installed
# at address 0
config DCACHE_RAM_BASE
	hex
	default 0x10000

# Memory at 0xa0000 decodes to VGA
config DCACHE_RAM_SIZE
	hex
	default 0x90000

# Do not show IFD/blob options since QEMU doesn't care
config HAVE_INTEL_FIRMWARE
	bool
	default n

config C_ENV_BOOTBLOCK_SIZE
	hex
	default 0xc000

config DCACHE_BSP_STACK_SIZE
	hex
	default 0x4000

# Yanked from soc picaso since we can't bring in all that FSP crap

config PICASSO_UART
	bool "UART controller on Picasso"
	default y
	select DRIVERS_UART_8250MEM
	select DRIVERS_UART_8250MEM_32
	select NO_UART_ON_SUPERIO
	select UART_OVERRIDE_REFCLK
	help
	  There are four memory-mapped UARTs controllers in Picasso at:
	  0: 0xfedc9000
	  1: 0xfedca000
	  2: 0xfedc3000
	  3: 0xfedcf000

config CONSOLE_UART_BASE_ADDRESS
	depends on CONSOLE_SERIAL && PICASSO_UART
	hex
	default 0xfedc9000 if UART_FOR_CONSOLE = 0
	default 0xfedca000 if UART_FOR_CONSOLE = 1
	default 0xfedc3000 if UART_FOR_CONSOLE = 2
	default 0xfedcf000 if UART_FOR_CONSOLE = 3

config DRIVERS_I2C_DESIGNWARE_CLOCK_MHZ
	int
	default 150


endif # BOARD_AMD_ROMEPSP
```

## src/soc/amd/romepsp/Kconfig
```kconfig
# SPDX-License-Identifier: GPL-2.0-only

config SOC_AMD_ROMEPSP
	bool
	help
	  AMD Picasso support

if SOC_AMD_ROMEPSP

config CPU_SPECIFIC_OPTIONS
	def_bool y
	select ARCH_BOOTBLOCK_X86_32
	select ARCH_VERSTAGE_X86_32
	select ARCH_ROMSTAGE_X86_32
	select ARCH_RAMSTAGE_X86_32
	select X86_AMD_FIXED_MTRRS
	select HAVE_CF9_RESET
	select PARALLEL_MP
	select PARALLEL_MP_AP_WORK
	select IOAPIC
	select RTC
	select TSC_MONOTONIC_TIMER
	# guesses
	select SOC_AMD_COMMON_BLOCK_ACPI
	select SOC_AMD_COMMON_BLOCK_ACPIMMIO

config CPU_ADDR_BITS
	int
	default 48

config MMCONF_BASE_ADDRESS
	hex
	default 0xF8000000

config MMCONF_BUS_NUMBER
	int
	default 64

config ROMEPSP_ACPI_IO_BASE
	hex
	default 0x800
	help
	  Base address for the ACPI registers.

config ACPI_CPU_STRING
	string
	default "\\_PR.C%03d"

endif # SOC_AMD_ROMEPSP
```
